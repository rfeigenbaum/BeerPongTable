#include "LargeFont.h"

namespace LegacyFonts {
    uint8_t LargeFont::Font[10][12] = {
				{0x7E, 0xC1, 0xC1, 0xA1, 0xA1, 0x91, 0x89, 0x85, 0x85, 0x83, 0x83, 0x7E}, //0
				{0x18, 0x38, 0x78, 0x18, 0x18, 0x18, 0x18, 0x18, 0x18, 0x18, 0x18, 0x7E}, //1
				{0x18, 0x66, 0x81, 0x81, 0x2, 0xC, 0x30, 0x40, 0x40, 0x80, 0x80, 0xFF},   //2
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				{0x3C, 0x42, 0x81, 0x81, 0x81, 0x43, 0x3D, 0x1, 0x81, 0x81, 0x62, 0x1C},  //9
			};

	int8_t LargeFont::getCharacterHeight() {
		return characterHeight;
	}
	int8_t LargeFont::getCharacterWidth() {
		return characterWidth;
	}
	int8_t LargeFont::getCharacterWidth(char c) {
		return characterWidth;
	}
	void LargeFont::printCharacter(CRGB *leds, CRGB color, int x, int y, char c) {
		int characterIndex = c - '0';
		Serial.println(c);
		Serial.println(characterIndex);
		if(characterIndex >= 0 && characterIndex < arrayLength) {
			for (int i = 0; i < characterHeight; i++)
			{
				for (int m = 0; m <= 7; m++)
				{
					if (FontHelpers::getBit(Font[characterIndex][i], m))
						leds[MatrixHelpers::xy(x + (7 - m), i + y)] = color;
				}
			}
		}
	}

}